// thank you to urob https://github.com/urob/zmk-config/blob/main/config/mouse.dtsi
#include <dt-bindings/zmk/mouse.h>

&mmv {
  acceleration-exponent = <1>;
  time-to-max-speed-ms = <500>;
  delay-ms = <0>;
};

&msc {
  acceleration-exponent = <0>;
  delay-ms = <0>;
};

#define U_MOUSE_MOVE_MAX 1500
#define U_MOUSE_SCRL_MAX 10

#undef MOVE_UP
#undef MOVE_DOWN
#undef MOVE_LEFT
#undef MOVE_RIGHT
#define MOVE_UP MOVE_Y(-U_MOUSE_MOVE_MAX)
#define MOVE_DOWN MOVE_Y(U_MOUSE_MOVE_MAX)
#define MOVE_LEFT MOVE_X(-U_MOUSE_MOVE_MAX)
#define MOVE_RIGHT MOVE_X(U_MOUSE_MOVE_MAX)

#undef SCRL_UP
#undef SCRL_DOWN
#undef SCRL_LEFT
#undef SCRL_RIGHT
#define SCRL_UP MOVE_Y(U_MOUSE_SCRL_MAX)
#define SCRL_DOWN MOVE_Y(-U_MOUSE_SCRL_MAX)
#define SCRL_LEFT MOVE_X(-U_MOUSE_SCRL_MAX)
#define SCRL_RIGHT MOVE_X(U_MOUSE_SCRL_MAX)

#define U_BTN1 &mkp MB1
#define U_BTN2 &mkp MB2
#define U_BTN3 &mkp MB3
#define U_MS_U &mmv MOVE_UP
#define U_MS_D &mmv MOVE_DOWN
#define U_MS_L &mmv MOVE_LEFT
#define U_MS_R &mmv MOVE_RIGHT
#define U_WH_U &msc SCRL_UP
#define U_WH_D &msc SCRL_DOWN
#define U_WH_L &msc SCRL_LEFT
#define U_WH_R &msc SCRL_RIGHT
